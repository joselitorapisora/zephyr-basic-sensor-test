#include <stdint.h>
#include <stdio.h>
#include <zephyr/device.h>
#include <zephyr/kernel.h>
#include <zephyr/drivers/sensor.h>
#include <zephyr/drivers/display.h>
#include <zephyr/display/cfb.h>
#include <zephyr/logging/log.h>
#include <zephyr/display/cfb.h>

#define DISPLAY_BUFFER_PITCH 132
uint8_t msgBuf[100];

// Fullscreen welcome image
uint8_t imageBuf[1056] = {
0xff, 0xff, 0xff, 0xff, 0xff, 0xff, 0xff, 0xff, 0xff, 0xff, 0xff, 0xff, 0xff, 0xff, 0xff, 0xff, 
0xff, 0xff, 0xff, 0xff, 0xff, 0xff, 0xff, 0xff, 0xff, 0xff, 0xff, 0xff, 0xff, 0xff, 0xff, 0xff, 
0xff, 0xff, 0xff, 0xff, 0xff, 0xff, 0xff, 0xff, 0xff, 0xff, 0xff, 0xff, 0xff, 0xff, 0xff, 0xff, 
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0xff, 0xff, 0xff, 0xff, 0xff, 0xff, 0xff, 0xff, 0xff, 0xff, 0xff, 0xff, 0xff, 0xff, 0xff, 0xff};


static const struct device *display = DEVICE_DT_GET(DT_ALIAS(sh1107));
const struct device *const tempSensor = DEVICE_DT_GET(DT_ALIAS(mcp9808));
const struct device *const lightSensor = DEVICE_DT_GET(DT_ALIAS(opt3001));
int ret;

int  main(void)
{
  struct sensor_value tempVal;
  struct sensor_value lightVal;

  // Check devices
	if (!device_is_ready(display)) {
		printf("Device %s is not ready.\n", display->name);
		return 0;
	}
    if (!device_is_ready(tempSensor)) {
		printf("Device %s is not ready.\n", tempSensor->name);
		return 0;
	}
    if (!device_is_ready(lightSensor)) {
		printf("Device %s is not ready.\n", lightSensor->name);
		return 0;
	}

  // Display welcome image for 3 sec
  struct display_capabilities capabilities;
  display_get_capabilities(display, &capabilities);  
  const struct display_buffer_descriptor buf_desc = {
    .width = capabilities.x_resolution,
    .height = capabilities.y_resolution,
    .buf_size = capabilities.x_resolution * capabilities.y_resolution,
    .pitch = capabilities.x_resolution
  };
  if (display_write(display, 0, 0, &buf_desc, imageBuf) != 0) {
    printf("could not write to display");
  }
  k_sleep(K_MSEC(3000));


  // Initialize cfb framebuffer
  if (cfb_framebuffer_init(display) != 0) {
      printf("could not initialize CFB");
      return;
  }
  if (cfb_framebuffer_clear(display, true) != 0) {
      printf("could not clear display");
      return;
  }


  while (1) 
  {
    // Fetch data from sensors
    ret = sensor_sample_fetch(tempSensor);
    ret |= sensor_sample_fetch(lightSensor);
    if (ret) {
        printf("Sample fetch error: %d\n", ret);
        return 0;
    }

    // Move channel data to buffers
    ret = sensor_channel_get(tempSensor, SENSOR_CHAN_AMBIENT_TEMP, &tempVal);
    ret |= sensor_channel_get(lightSensor, SENSOR_CHAN_LIGHT, &lightVal);
    if (ret) {
        printf("Channel get error: %d\n", ret);
        return 0;
    }

    // JMR: Writing spaces to framebuffer instead of doing a clear to avoid flicker...
    //cfb_framebuffer_clear(display, true);
    cfb_print(display, "               ", 0, 0);
    cfb_print(display, "               ", 0, 15);

    sprintf((char *) msgBuf, "Temp : %d.%02d", tempVal.val1, tempVal.val2/10000);
    cfb_print(display, msgBuf, 0, 0);
    sprintf((char *) msgBuf, "Light: %d.%02d", lightVal.val1, lightVal.val2/10000);
    cfb_print(display, msgBuf, 0, 15);
    cfb_framebuffer_finalize(display);
    k_sleep(K_MSEC(300));
  }
  return 0;
}